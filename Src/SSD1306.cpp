#include "SSD1306.h"

namespace FwLogger
{

	const uint8_t builtin_font[] =
	{
		0x00, 0x00, 0x00, 0x00, 0x00, // sp
		0x00, 0x00, 0x2f, 0x00, 0x00, // !
		0x00, 0x07, 0x00, 0x07, 0x00, // "
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		0x10, 0x08, 0x10, 0x08, 0x00, // ~
	};

	void SSD1306::isr()
	{
		_isrFlag = true;
	}

	SSD1306::SSD1306(I2C_HandleTypeDef* hi2c, uint8_t addr, uint16_t width, uint16_t height) : Module("SSD1306",'D', 1, 0)
	{
		_hi2c = hi2c;
		_addr = addr;
		_width = width;
		_height = height;

		_color = White;
	}

	void SSD1306::Init()
	{
		/* Init LCD */
		writeCommand(0xAE); //display off
		writeCommand(0x20); //Set Memory Addressing Mode
		writeCommand(0x00); //00,Horizontal Addressing Mode;01,Vertical Addressing Mode;10,Page Addressing Mode (RESET);11,Invalid
		writeCommand(0xB0); //Set Page Start Address for Page Addressing Mode,0-7
		writeCommand(0xC0); //Set COM Output Scan Direction
		writeCommand(0x00); //---set low column address
		writeCommand(0x10); //---set high column address
		writeCommand(0x40); //--set start line address
		writeCommand(0x81); //--set contrast control register
		writeCommand(0xFF);
		writeCommand(0xA0); //--set segment re-map 0 to 127
		writeCommand(0xA6); //--set normal display
		writeCommand(0xA8); //--set multiplex ratio(1 to 64)
		writeCommand(0x1F); //
		writeCommand(0xA4); //0xa4,Output follows RAM content;0xa5,Output ignores RAM content
		writeCommand(0xD3); //-set display offset
		writeCommand(0x00); //-not offset
		writeCommand(0xD5); //--set display clock divide ratio/oscillator frequency
		writeCommand(0xF0); //--set divide ratio
		writeCommand(0xD9); //--set pre-charge period
		writeCommand(0x22); //
		writeCommand(0xDA); //--set com pins hardware configuration
		writeCommand(0x02);
		writeCommand(0xDB); //--set vcomh
		writeCommand(0x20); //0x20,0.77xVcc
		writeCommand(0x8D); //--set DC-DC enable
		writeCommand(0x14); //
		writeCommand(0xAF); //--turn on SSD1306 panel

		setColor(White);
		fill();

		updateScreen();

		_cursorX = 0;
		_cursorY = 0;
		for(int i = 0; i < 128*4; ++i)
			_buf[i] = 0;

		_initialized = 1;
	}

	void SSD1306::setColor(Color color)
	{
		_color = color;
	}

	void SSD1306::fill(Color color)
	{
		/* Set memory */
		uint32_t i;

		for(i = 0; i < sizeof(_buf); i++)
		{
			_buf[i] = (color == White) ? 0xff : 0x00;
		}
	}

	void SSD1306::updateScreen(void)
	{
		writeCommand(0xB0);
		writeCommand(0x00);
		writeCommand(0x10);

		//HAL_I2C_Mem_Write(_hi2c, _addr, 0x40, 1, _buf, _width*4, 1000);
		_cmds.push_back(0x100);
	}

	void SSD1306::drawPixel(uint8_t x, uint8_t y, Color color)
	{
		if (x >= _width || y >= _height) return;

		// Draw in the right color
		if (color == White)
		{
			_buf[x + (y / 8) * _width] |= 1 << (y % 8);
		}
		else
		{
			_buf[x + (y / 8) * _width] &= ~(1 << (y % 8));
		}
	}

	char SSD1306::writeChar(char ch)
	{
		const uint8_t* charGlyph;
		if(ch < ' ') charGlyph = &builtin_font[0];
		else if(ch > '}') charGlyph = &builtin_font[0];
		else charGlyph = &builtin_font[5*(ch-' ')];

		if(_cursorX + 6 > _width)
		{
			_cursorY++;
			_cursorX = 0;
		}

		if(_cursorY > _height/4)
			_cursorY = 0;

		_buf[_cursorX+_cursorY*_width] = 0;
		for(int i = 1; i < 6; ++i)
			_buf[_cursorX+_cursorY*_width+i] = charGlyph[i-1];

		_cursorX += 6;

		return ch;
	}

	char SSD1306::writeString(char* str)
	{
		// Write until null-byte
		while (*str)
		{
			if (writeChar(*str) != *str)
			{
				// Char could not be written
				return *str;
			}

			// Next char
			str++;
		}

		// Everything ok
		return 0;
	}

	void SSD1306::setCursor(uint8_t x, uint8_t y)
	{
		_cursorX = x;
		_cursorY = y;
	}

	void SSD1306::writeCommand(uint8_t command)
	{
		//HAL_I2C_Mem_Write(_hi2c, _addr, 0, 1, &command, 1, 1000);
		_cmds.push_back(command);
		_isrFlag = true;
	}

	bool SSD1306::loop()
	{
		if(_isrFlag)
		{
			_isrFlag = false;
			uint16_t* cmd = _cmds.at_front();
			if(cmd == nullptr) // no left op
			{
				_pendingOp = false;
			}
			else
			{
				_cmds.delete_front();
				_pendingOp = true;
				if(*cmd < 0xff)
				{
					HAL_I2C_Mem_Write_IT(_hi2c, _addr, 0, 1, reinterpret_cast<uint8_t*>(cmd), 1);
				}
				else
				{
					HAL_I2C_Mem_Write_IT(_hi2c, _addr, 0x40, 1, _buf, _width*4);
				}
			}
		}
		return _pendingOp;
	}
}
